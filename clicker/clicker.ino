#include <SPI.h>
#include <Wire.h>
#include <Adafruit_GFX.h>
#include <Adafruit_SSD1306.h>
#include <Mouse.h>
#include <Keyboard.h>

Adafruit_SSD1306 display(128, 64, &Wire, -1);

int leftButton = 6;
int centerButton = 7;
int rightButton = 5;
int bluetooth = 11;

int lightPin = 8;

bool toolMode = true; //used in mining mode to save if it has a shovel or pickaxe
int newMode = 0; 

int transition1 = 0; //for when moving left and right to switch modes

volatile byte state = LOW; //saved if button is pressed

//icons for modes
const unsigned char pickaxe [] PROGMEM = {
  0x00, 0x00, 0x00, 0x00, 0x00, 0x00, 0x00, 0x00, 0x00, 0x00, 0x03, 0xf8, 0x00, 0x00, 0x00, 0x07, 
  0xf8, 0x00, 0x00, 0x00, 0x0f, 0xff, 0x00, 0x00, 0x00, 0x03, 0xff, 0x80, 0x00, 0x00, 0x00, 0x1f, 
  0x80, 0x00, 0x00, 0x00, 0x1f, 0x80, 0x00, 0x00, 0x00, 0x3f, 0xcf, 0xff, 0xe0, 0x00, 0x7b, 0xcf, 
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  0x01, 0xff, 0xff, 0xff, 0xe0, 0x00, 0x00, 0x00, 0x00, 0x00, 0x00, 0x00, 0x00, 0x00, 0x00
};

const unsigned char elytra [] PROGMEM = { 
  0x00, 0x00, 0x00, 0x00, 0x00, 0x00, 0x00, 0x00, 0x00, 0x00, 0x00, 0x00, 0x00, 0x00, 0x00, 0x00, 
  0xfe, 0x0f, 0xe0, 0x0, 0x00, 0xfe, 0x0f, 0xe0, 0x00, 0x00, 0xfe, 0x0f, 0xe0, 0x00, 0x1f, 0x07, 
  0xfc, 0x1f, 0x00, 0x1f, 0x07, 0xfc, 0x1f, 0x00, 0xe0, 0x06, 0x0c, 0x00, 0xe0, 0xe0, 0x06, 0x0c, 
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  0x07, 0xc0, 0x00, 0x7c, 0x00, 0x00, 0x00, 0x00, 0x00, 0x00, 0x00, 0x00, 0x00, 0x00, 0x00
};

const unsigned char endBridging [] PROGMEM = {
  0x00, 0x00, 0x00, 0x00, 0x00, 0x00, 0x00, 0x00, 0x00, 0x00, 0x01, 0xe0, 0x00, 0x00, 0x00, 0x00, 
  0x00, 0x00, 0x00, 0x00, 0x0e, 0x1c, 0x00, 0x00, 0x00, 0x10, 0x02, 0x00, 0x00, 0x00, 0x23, 0xf1, 
  0x00, 0x00, 0x00, 0x67, 0xf9, 0x80, 0x00, 0x00, 0x6f, 0x3d, 0x8f, 0xff, 0xe0, 0x8e, 0x1c, 0x4e, 
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  0x01, 0xff, 0xff, 0xff, 0xe0, 0x00, 0x00, 0x00, 0x00, 0x00, 0x00, 0x00, 0x00, 0x00, 0x00
};

const unsigned char crystal [] PROGMEM = {
  0x7f, 0xff, 0xff, 0xff, 0xc0, 0x7f, 0xff, 0xff, 0xff, 0xc0, 0x78, 0x01, 0xf0, 0x03, 0xc0, 0x70, 
  0x00, 0xe0, 0x01, 0xc0, 0x70, 0x00, 0xe0, 0x01, 0xc0, 0x70, 0x03, 0xf8, 0x01, 0xc0, 0x70, 0x03, 
  0xf8, 0x01, 0xc0, 0x70, 0x07, 0xfc, 0x01, 0xc0, 0x70, 0x0f, 0xff, 0x01, 0xc0, 0x70, 0x1f, 0xff, 
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  0x78, 0x01, 0xf0, 0x03, 0xc0, 0x7f, 0xff, 0xff, 0xff, 0xc0, 0x7f, 0xff, 0xff, 0xff, 0xc0
};

const unsigned char sword [] PROGMEM = {
  0x00, 0x00, 0x00, 0x00, 0x00, 0x00, 0x00, 0x00, 0x00, 0x00, 0x00, 0x00, 0x00, 0x00, 0x00, 0x00, 
  0x00, 0x00, 0x3f, 0x00, 0x00, 0x00, 0x00, 0x7f, 0x00, 0x00, 0x00, 0x00, 0xf3, 0x00, 0x00, 0x00, 
  0x01, 0xe3, 0x00, 0x00, 0x00, 0x03, 0xc7, 0x00, 0x00, 0x00, 0x07, 0x8f, 0x00, 0x00, 0x00, 0x0f, 
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  0x00, 0x00, 0x00, 0x00, 0x00, 0x00, 0x00, 0x00, 0x00, 0x00, 0x00, 0x00, 0x00, 0x00, 0x00
};

const unsigned char button [] PROGMEM = {
  0x00, 0x00, 0x00, 0x00, 0x00, 0x00, 0x00, 0x00, 0x00, 0x00, 0x00, 0x3f, 0xff, 0xff, 0x80, 0x00, 
  0x20, 0x00, 0x00, 0x80, 0x00, 0x20, 0x00, 0x00, 0x80, 0x00, 0x20, 0x00, 0x00, 0x80, 0x00, 0x20, 
  0x00, 0x00, 0x80, 0x00, 0x20, 0x00, 0x00, 0x80, 0x00, 0x20, 0x00, 0x00, 0x80, 0x00, 0x20, 0x00, 
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  0x38, 0x00, 0x00, 0x00, 0x00, 0x00, 0x00, 0x00, 0x00, 0x00, 0x00, 0x00, 0x00, 0x00, 0x00
};

const unsigned char logo [] PROGMEM = {
  0x00, 0x00, 0x03, 0xf0, 0x00, 0x00, 0x00, 0x00, 0x00, 0x00, 0x03, 0xf8, 0x00, 0x00, 0x00, 0x00, 
  0x00, 0x00, 0x03, 0xf8, 0x00, 0x00, 0x00, 0x00, 0x00, 0x00, 0x07, 0xfc, 0x00, 0x00, 0x00, 0x00, 
  0x00, 0x00, 0x07, 0xfc, 0x00, 0x00, 0x00, 0x00, 0x00, 0x00, 0x0f, 0xff, 0x80, 0x00, 0x00, 0x00, 
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  0xff, 0xff, 0xff, 0xff, 0xff, 0xff, 0xff, 0xff, 0xff, 0xff, 0xff, 0xff, 0xff, 0xff, 0xff, 0xff
};


//bitmaps: pickaxe, elytra, endBridging, crystal, sword, button

String text[] = {"Mining", "Flying", "Type", "Spammer", "Attack", "Clicker"};
/*Modes:
 * Mining: It mines for me in minecraft.
 * Flying: Continuously right clicks, which could be used to keep right clicking fireworks and fly.
 * Type: Part of another project that turns off computer.
 * Spammer: Discord aniversary stuff.
 * Attack: For afking at skeleton grinder.
 * Cliker: Keeps clicking (would point at button) to not get kicked for idling.
 */


int textX;
int textY;
int textW;
int textH;

int stringLength;
String newString;
int dontDisplay = 0;

int choosen = 0;

void checkTool() { //for mining mode
  int lightRead = digitalRead(lightPin);
  if(lightRead == 1) {
    Keyboard.print('5');
    toolMode = false;
  } else {
    Keyboard.print('6');
    toolMode = true;
  }
}
/* I put a color sensor in front of my screen. I also made a texture pack so gravel is white and stone is black.
 * So when the player is infront of gravel, it switches to a shovel using the hotbar key, and any other time it 
 * uses the pickaxe. Unfortunately, I only took a picture of this.
 */

void updateDisplay(int offset, int option) { //draws icons and message on display, offset is for moving the info when switching modes

  //display image based on option choosen
  switch(option) {
    case 0:
      display.drawBitmap(85 + offset, 20, pickaxe, 35, 35, WHITE);
      break;
    case 1:
      display.drawBitmap(85 + offset, 20, elytra, 35, 35, WHITE);
      break;
    case 2:
      display.drawBitmap(85 + offset, 20, endBridging, 35, 35, WHITE);
      break;
    case 3:
      display.drawBitmap(85 + offset, 20, crystal, 35, 35, WHITE);
      break;
    case 4:
      display.drawBitmap(85 + offset, 20, sword, 35, 35, WHITE);
      break;
    case 5:
      display.drawBitmap(85 + offset, 20, button, 35, 35, WHITE);
      break;
  }

  //draw Text
  display.setCursor(9 + offset, 31); 
  display.setTextColor(WHITE);
  display.setTextSize(2);
  display.cp437(true); 

  //if the text goes outside the bounds of the display, it would go to the next line, so I made this code
  //that keeps reducing the text until it fits.
  stringLength = text[option].length() - 2; 
  dontDisplay = 0;
  newString = text[option];
  display.getTextBounds(newString, 9 + offset, 31, &textX, &textY, &textW, &textH); 
  while(9 + offset + textW > 128) {
    newString = newString.substring(0, stringLength);
    stringLength--;
    if(stringLength < 0) { //eventually it will go completely off the screen, so this prevents an infinite loop
      dontDisplay = 1;
      break;
    }
    display.getTextBounds(newString, 9 + offset, 31, &textX, &textY, &textW, &textH);
  }
  if(dontDisplay == 0) {
    display.print(newString);
  }

  if(choosen == 1) {
    display.drawRect(3 + offset, 17, 123, 43, WHITE); //draws rectangle around if chosen
  }
}

int torch = 0;
int option1 = 0;

void choose() {
  state = !state;
}

int lastState = 1;

void setup() {
  pinMode(leftButton, INPUT_PULLUP);
  pinMode(centerButton, INPUT_PULLUP);
  pinMode(rightButton, INPUT_PULLUP);
  pinMode(lightPin, INPUT);
  pinMode(bluetooth, INPUT);

  attachInterrupt(digitalPinToInterrupt(7), choose, FALLING); //center button to turn on and off mode
  
  Serial.begin(9600);
  Mouse.begin();
  Keyboard.begin();
  
  if(!display.begin(SSD1306_SWITCHCAPVCC, 0x3C)) {
    Serial.println(F("SSD1306 allocation failed"));
    for(;;);
  }

  display.clearDisplay();
  display.drawBitmap(0, 19, logo, 128, 45, WHITE);
  display.display();
  delay(2000);

  display.clearDisplay();
  updateDisplay(0, 0);
  display.display(); 
}

void checkButton() { //checks if button has been pressed, and if so updates display to show that, although it still has to finish the current loop
  if(state == HIGH) {
    state = LOW;
    if(choosen == 0) {
      choosen = 1;
      newMode = 1;
    } else {
      choosen = 0;
    }

    if(option1 == 2) {
      Mouse.release();
      Keyboard.releaseAll();
    }

    display.clearDisplay();
    updateDisplay(0, option1);
    display.display();

    delay(1000);
  }
}
  
void loop() {
  int right = digitalRead(rightButton);
  int center = digitalRead(centerButton);
  int left = digitalRead(leftButton);

  if(left == 0) { //moves left 
    choosen = 0;
    
    while(true) {
      display.clearDisplay();
      
      transition1 += 10;
      updateDisplay(transition1, option1);
      
      if(-128 + transition1 > 0) { 
        if(option1 + 1 > 5) {
          updateDisplay(0, 0);
          display.display();
          option1 = 0;
        } else {
          updateDisplay(0, option1 + 1);
          display.display();
          option1++;
        }
        break;
      } else {
        if(option1 + 1 > 5) {
          updateDisplay(-128 + transition1, 0);
        } else {
          updateDisplay(-128 + transition1, option1 + 1);
        }
      }
    
      display.display();
    }
    transition1 = 0;
  } else if(right == 0) { //moves right
    choosen = 0;
    
    while(true) {
      display.clearDisplay();
      
      transition1 -= 10;
      updateDisplay(transition1, option1);
      
      if(128 + transition1 < 0) {
        if(option1 - 1 < 0) {
          updateDisplay(0, 5);
          display.display();
          option1 = 5;
        } else {
          updateDisplay(0, option1 - 1);
          display.display();
          option1--;
        }
        break;
      } else {
        if(option1 - 1 < 0) {
          updateDisplay(128 + transition1, 5);
        } else {
          updateDisplay(128 + transition1, option1 - 1);
        }
      }
    
      display.display();
    }
    transition1 = 0;
  } 

  checkButton();
  if(newMode == 1) { //when I was trying to debug not starting immediently, switch messed up the specefic steps for mining
    //Keyboard.press('m');
    //Mouse.press(MOUSE_LEFT); //just started by pressing a button, then stops after two seconds to move on to the mode
    delay(2000);
    Keyboard.releaseAll();
    Mouse.release(MOUSE_LEFT);
    newMode = 0;
  }

  if(option1 == 0 && choosen == 1) { //mining mode
    checkTool();
    
    Mouse.press(); //mine top block
    if(toolMode == true) { //depending if it is using shovel or pickaxe, it mines longer or shorter for the tool
      delay(450);
    } else {
      delay(200);
    }
    Mouse.release();

    checkButton();
    checkTool();
    
    Mouse.move(0, 80, 0); //move down
    Mouse.move(0, 80, 0);

    delay(750);
    checkButton();
    checkTool();
    
    Mouse.press(); // mine bottom block
    if(toolMode == true) {
      delay(450);
    } else {
      delay(350);
    }
    Mouse.release();

    checkButton();
    checkTool();
    
    Mouse.move(0, -80, 0); //move back up
    Mouse.move(0, -80, 0);

    checkButton();
    checkTool();

    if(torch == 5) { //checks if it has moved enough blocks to place torch
      Mouse.move(80, 0, 0);
      Mouse.move(80, 0, 0); //move to the side

      checkButton();
  
      Mouse.press(MOUSE_RIGHT); //place torch
      delay(400);
      Mouse.release(MOUSE_RIGHT);

      checkButton();
  
      Mouse.move(-80, 0, 0); //move to center
      Mouse.move(-80, 0, 0);
      torch = 0;

      checkButton();
      checkTool();
    }

    Keyboard.press('w'); //move forward
    delay(300);
    Keyboard.releaseAll();

    checkButton();
    checkTool();

    torch++; //keep track how many blocks it has moved
    
    delay(500);

    checkButton();
    checkTool();
  } else if(choosen == 1 && option1 == 5) {
    Mouse.click(MOUSE_RIGHT);

    checkButton();
    
    delay(1000);
  } else if(choosen == 1 && option1 == 4) { //attack mode
    Mouse.click(MOUSE_LEFT);
    checkButton();
    
    delay(1000);
  } else if(choosen == 1 && option1 == 3) { //spammer mode
    /*Mouse.move(random(-500, 500), random(-500, 500), random(-500, 500));
    delay(10);*/  //use to just move randomly before
    for(int i = 0; i < 100; i++) {
      Keyboard.press('w');
      delay(15); //if it's too fast, discord crashes
    }
    delay(250);
    checkButton();
  } else if(choosen == 1 && option1 == 2) { //type mode, turns off computer when it pin changes from positive to negative
    /*/Keyboard.press(KEY_LEFT_SHIFT);
    Keyboard.press('w');
    //Mouse.press(MOUSE_RIGHT);
    checkButton();*/
    
    checkButton();
    delay(1000);
    int bState = digitalRead(bluetooth);
    Serial.println(bState);
    if(lastState != bState) {
      if(lastState == 1 && bState == 0) {
        Serial.println("changed");
        Keyboard.press(KEY_LEFT_CTRL);
        Keyboard.press(KEY_LEFT_GUI);
        Keyboard.press('q');
      }
      lastState = bState;
    }
    checkButton();
    delay(500);
    checkButton();
    Keyboard.releaseAll();
    checkButton();
  } else if(choosen == 1 && option1 == 1) { //flying mode
    Mouse.click(MOUSE_RIGHT);

    checkButton();
    
    delay(1000);
    checkButton();
    delay(1000);
    checkButton();
    delay(1000);
    checkButton();
    delay(1000);
    checkButton();
    delay(1000);
    checkButton();
    delay(1000);
    checkButton();
  } else { //just releases everything just in case anything is being pressed
    Mouse.release(MOUSE_LEFT);
    Mouse.release(MOUSE_RIGHT);
    Keyboard.releaseAll();
  }
}

//bitmaps: pickaxe, elytra, endBridging, crystal, sword, button
